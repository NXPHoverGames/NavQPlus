## conf/machine/imx8mpsom.conf
```bitbake
#@TYPE: Machine
#@NAME: Emcraft Systems i.MX8MP 2GB LPDDR4 SOM
#@SOC: i.MX8MP
#@DESCRIPTION: Machine configuration for Emcraft Systems i.MX8MP 2GB LPDDR4 SOM
#@MAINTAINER: Emcraft Systems <customer-service@emcraft.com>

MACHINE="imx8mpsom"

require conf/machine/imx8mp-lpddr4-evk.conf

MACHINEOVERRIDES =. "mx8:mx8m:mx8mp:mx8mpsom:"

MACHINE_FEATURES += " pci wifi bluetooth qca9377 bcm43455"

KERNEL_DEVICETREE = "emcraft/imx8mp-som.dtb"

UBOOT_CONFIG ??= "sd"
UBOOT_CONFIG[sd] = "imx8mp_evk_defconfig,sdcard"
UBOOT_CONFIG[mfgtool] = "imx8mp_evk_defconfig"

# Set DDR FIRMWARE
DDR_FIRMWARE_VERSION = "202006"
DDR_FIRMWARE_NAME = " \
	lpddr4_pmu_train_1d_dmem_${DDR_FIRMWARE_VERSION}.bin \
	lpddr4_pmu_train_1d_imem_${DDR_FIRMWARE_VERSION}.bin \
	lpddr4_pmu_train_2d_dmem_${DDR_FIRMWARE_VERSION}.bin \
	lpddr4_pmu_train_2d_imem_${DDR_FIRMWARE_VERSION}.bin \
"

# Set u-boot DTB
UBOOT_DTB_NAME = "imx8mp-evk.dtb"

# Set imx-mkimage boot target
IMXBOOT_TARGETS = "flash_evk"

# Set Serial console
SERIAL_CONSOLES = "115200;ttymxc1"

IMAGE_BOOTLOADER = "imx-boot"

LOADADDR = ""
UBOOT_SUFFIX = "bin"
UBOOT_MAKE_TARGET = ""
IMX_BOOT_SEEK = "32"

OPTEE_BIN_EXT = "8mp"

# Add additional firmware
#MACHINE_FIRMWARE_append = " linux-firmware-ath10
```

## conf/machine/imx8mpsomdesktop.conf
```bitbake
MACHINE="imx8mpsom"
require conf/machine/imx8mpsom.conf

require conf/machine/include/ubuntubasics.inc
```
